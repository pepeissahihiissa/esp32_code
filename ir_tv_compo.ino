#include <Arduino.h>
#include <IRremoteESP8266.h>
#include <IRsend.h>

const uint16_t kIrLedPin = 4;
IRsend irsend(kIrLedPin);

void setup() {
  Serial.begin(115200);
  irsend.begin();
  Serial.println("IR Remote Controller Ready");
  Serial.println("Commands:");
  Serial.println("  DENON_POWER, DENON_VOL_UP, DENON_VOL_DOWN");
  Serial.println("  TV_POWER, TV_INPUT, TV_UP, TV_DOWN, TV_OK");
}

void loop() {
  if (Serial.available() > 0) {
    String command = Serial.readStringUntil('\n');
    command.trim();
    
    // DENON コンポ
    if (command == "DENON_POWER") {
      irsend.sendDenon(0x220C, 15);
      Serial.println("OK: DENON 電源");
    }
    else if (command == "DENON_VOL_UP") {
      irsend.sendDenon(0x223C, 15);
      Serial.println("OK: DENON ボリューム+");
    }
    else if (command == "DENON_VOL_DOWN") {
      irsend.sendDenon(0x213C, 15);
      Serial.println("OK: DENON ボリューム-");
    }
    
    // TCL テレビ
    else if (command == "TV_POWER") {
      uint16_t rawData[83] = {3412, 1744, 388, 400, 412, 402, 414, 1322, 388, 1320, 388, 398, 412,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 400, 414};
      irsend.sendRaw(rawData, 83, 38);
      Serial.println("OK: TV 電源");
    }
    else if (command == "TV_INPUT") {
      uint16_t rawData[83] = {3416, 1738, 392, 394, 418, 396, 416, 1320, 390, 1318, 392, 396, 418,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 1292, 420};
      irsend.sendRaw(rawData, 83, 38);
      Serial.println("OK: TV 入力切替");
    }
    else if (command == "TV_UP") {
      uint16_t rawData[83] = {3436, 1714, 416, 376, 436, 378, 438, 1296, 414, 1294, 414, 376, 438,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 378, 436};
      irsend.sendRaw(rawData, 83, 38);
      Serial.println("OK: TV 上");
    }
    else if (command == "TV_DOWN") {
      uint16_t rawData[83] = {3412, 1742, 388, 398, 414, 402, 412, 1324, 388, 1320, 388, 398, 414,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 398, 414};
      irsend.sendRaw(rawData, 83, 38);
      Serial.println("OK: TV 下");
    }
    else if (command == "TV_OK") {
      uint16_t rawData[83] = {3434, 1718, 418, 372, 438, 378, 436, 1298, 412, 1296, 412, 376, 436,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 1296, 412};
      irsend.sendRaw(rawData, 83, 38);
      Serial.println("OK: TV 決定");
    }
    
    else {
      Serial.print("ERROR: Unknown command: ");
      Serial.println(command);
    }
  }
}